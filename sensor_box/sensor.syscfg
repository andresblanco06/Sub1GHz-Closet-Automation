/**
 * @cliArgs --board "/ti/boards/CC1352R1_LAUNCHXL" --product "simplelink_cc13x2_26x2_sdk@4.10.00.78"
 * @versions {"data":"2020052512","timestamp":"2020052512","tool":"1.5.0+1397","templates":"2020052512"}
 */

/**
 * Import the modules used in this configuration.
 */
const CCFG       = scripting.addModule("/ti/devices/CCFG");
const rfdesign   = scripting.addModule("/ti/devices/radioconfig/rfdesign");
const Display    = scripting.addModule("/ti/display/Display");
const Display1   = Display.addInstance();
const GPIO       = scripting.addModule("/ti/drivers/GPIO", {}, false);
const GPIO1      = GPIO.addInstance();
const NVS        = scripting.addModule("/ti/drivers/NVS");
const NVS1       = NVS.addInstance();
const NVS2       = NVS.addInstance();
const RF         = scripting.addModule("/ti/drivers/RF");
const Button     = scripting.addModule("/ti/drivers/apps/Button");
const Button1    = Button.addInstance();
const Button2    = Button.addInstance();
const LED        = scripting.addModule("/ti/drivers/apps/LED");
const LED1       = LED.addInstance();
const LED2       = LED.addInstance();
const ti154stack = scripting.addModule("/ti/ti154stack/ti154stack");

/**
 * Write custom configuration values to the imported modules.
 */
CCFG.enableBootloader         = true;
CCFG.enableBootloaderBackdoor = true;
CCFG.dioBootloaderBackdoor    = 15;
CCFG.levelBootloaderBackdoor  = "Active low";
CCFG.enableCodeGeneration     = false;

Display1.$hardware                = system.deviceData.board.components.XDS110UART;
Display1.$name                    = "CONFIG_DISPLAY";
Display1.uart.$name               = "CONFIG_DISPLAY_UART";
Display1.uart.txPinInstance.$name = "CONFIG_PIN_UART_TX";
Display1.uart.rxPinInstance.$name = "CONFIG_PIN_UART_RX";

GPIO1.$name             = "CONFIG_GPIO_0";
GPIO1.pinInstance.$name = "CONFIG_PIN_4";

NVS1.$name                    = "CONFIG_NVSINTERNAL";
NVS1.internalFlash.$name      = "ti_drivers_nvs_NVSCC26XX0";
NVS1.internalFlash.regionBase = 0x52000;
NVS1.internalFlash.regionSize = 0x4000;

NVS2.$name                          = "CONFIG_NVSEXTERNAL";
NVS2.nvsType                        = "External";
NVS2.$hardware                      = system.deviceData.board.components.MX25R8035F;
NVS2.externalFlash.$name            = "ti_drivers_nvs_NVSSPI25X0";
NVS2.externalFlash.verifyBufferSize = 64;

Button1.$hardware                 = system.deviceData.board.components["BTN-1"];
Button1.$name                     = "CONFIG_BTN_LEFT";
Button1.gpioPin.$name             = "CONFIG_GPIO_BTN1";
Button1.gpioPin.pinInstance.$name = "CONFIG_PIN_BTN1";

Button2.$hardware                 = system.deviceData.board.components["BTN-2"];
Button2.$name                     = "CONFIG_BTN_RIGHT";
Button2.gpioPin.$name             = "CONFIG_GPIO_BTN2";
Button2.gpioPin.pinInstance.$name = "CONFIG_PIN_BTN2";

LED1.$hardware                               = system.deviceData.board.components.LED_RED;
LED1.$name                                   = "CONFIG_LED_RED";
LED1.dimmable                                = true;
LED1.pwmPin.$name                            = "CONFIG_GPIO_RLED";
LED1.pwmPin.timerObject.$name                = "CONFIG_GPTIMER_0";
LED1.pwmPin.timerObject.pwmPinInstance.$name = "CONFIG_PIN_5";

LED2.$hardware                               = system.deviceData.board.components.LED_GREEN;
LED2.$name                                   = "CONFIG_LED_GREEN";
LED2.dimmable                                = true;
LED2.pwmPin.$name                            = "CONFIG_GPIO_GLED";
LED2.pwmPin.timerObject.$name                = "CONFIG_GPTIMER_1";
LED2.pwmPin.timerObject.pwmPinInstance.$name = "CONFIG_PIN_6";

const NVSSPI25XDevice                                      = scripting.addModule("/ti/drivers/nvs/NVSSPI25XDevice", {}, false);
const NVSSPI25XDevice1                                     = NVSSPI25XDevice.addInstance({}, false);
NVSSPI25XDevice1.$name                                     = "CONFIG_NVS_SPI_0";
NVS2.externalFlash.spiFlashDevice                          = NVSSPI25XDevice1;
NVSSPI25XDevice1.slaveSelectGpioInstance.$name             = "CONFIG_GPIO_SPI_FLASH_CS";
NVSSPI25XDevice1.slaveSelectGpioInstance.pinInstance.$name = "CONFIG_PIN_0";

const SPI                          = scripting.addModule("/ti/drivers/SPI", {}, false);
const SPI1                         = SPI.addInstance({}, false);
NVSSPI25XDevice1.sharedSpiInstance = SPI1;
SPI1.$name                         = "Board_SPI_0";
SPI1.sclkPinInstance.$name         = "CONFIG_PIN_1";
SPI1.misoPinInstance.$name         = "CONFIG_PIN_2";
SPI1.mosiPinInstance.$name         = "CONFIG_PIN_3";

ti154stack.project                            = "sensorOAD";
ti154stack.lockProject                        = true;
ti154stack.reportingInterval                  = 5000;
ti154stack.pollingInterval                    = 15000;
ti154stack.phyType                            = "phy200kbps";
ti154stack.orphanBackoffInterval              = 30000;
ti154stack.transmitPower                      = "-20";
ti154stack.aesccmModule.$name                 = "CONFIG_AESCCM_0";
ti154stack.oadSettings.$name                  = "ti_ti154stack_oad_config_ti154stack_oad_mod0";
ti154stack.toadSettings.$name                 = "ti_ti154stack_oad_config_toad_config_ti154stack_toad_config0";
ti154stack.radioConfig.$name                  = "ti_devices_radioconfig_settings_prop0";
ti154stack.radioConfig.codeExportConfig.$name = "ti_devices_radioconfig_code_export_param0";

/**
 * Pinmux solution for unlocked pins/peripherals. This ensures that minor changes to the automatic solver in a future
 * version of the tool will not impact the pinmux you originally saw.  These lines can be completely deleted in order to
 * re-solve from scratch.
 */
Display1.uart.uart.$suggestSolution                               = "UART1";
Display1.uart.uart.txPin.$suggestSolution                         = "boosterpack.4";
Display1.uart.uart.rxPin.$suggestSolution                         = "boosterpack.3";
GPIO1.gpioPin.$suggestSolution                                    = "boosterpack.19";
Button1.gpioPin.gpioPin.$suggestSolution                          = "boosterpack.13";
Button2.gpioPin.gpioPin.$suggestSolution                          = "boosterpack.12";
LED1.pwmPin.timerObject.timer.$suggestSolution                    = "GPTM0";
LED1.pwmPin.timerObject.timer.pwmPin.$suggestSolution             = "boosterpack.39";
LED2.pwmPin.timerObject.timer.$suggestSolution                    = "GPTM0";
LED2.pwmPin.timerObject.timer.pwmPin.$suggestSolution             = "boosterpack.40";
NVSSPI25XDevice1.slaveSelectGpioInstance.gpioPin.$suggestSolution = "boosterpack.38";
SPI1.spi.$suggestSolution                                         = "SSI0";
SPI1.spi.sclkPin.$suggestSolution                                 = "boosterpack.7";
SPI1.spi.misoPin.$suggestSolution                                 = "boosterpack.14";
SPI1.spi.mosiPin.$suggestSolution                                 = "boosterpack.15";
SPI1.spi.dmaRxChannel.$suggestSolution                            = "DMA_CH3";
SPI1.spi.dmaTxChannel.$suggestSolution                            = "DMA_CH4";
