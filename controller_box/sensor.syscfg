/**
 * @cliArgs --board "/ti/boards/CC1352R1_LAUNCHXL" --product "simplelink_cc13x2_26x2_sdk@4.10.00.78"
 * @versions {"data":"2020021217","timestamp":"2020021217","tool":"1.4.0+1234","templates":"2020021217"}
 */

/**
 * Import the modules used in this configuration.
 */
const CCFG       = scripting.addModule("/ti/devices/CCFG");
const rfdesign   = scripting.addModule("/ti/devices/radioconfig/rfdesign");
const Display    = scripting.addModule("/ti/display/Display");
const Display1   = Display.addInstance();
const GPIO       = scripting.addModule("/ti/drivers/GPIO", {}, false);
const GPIO1      = GPIO.addInstance();
const GPIO2      = GPIO.addInstance();
const GPIO3      = GPIO.addInstance();
const GPIO4      = GPIO.addInstance();
const GPIO5      = GPIO.addInstance();
const NVS        = scripting.addModule("/ti/drivers/NVS");
const NVS1       = NVS.addInstance();
const NVS2       = NVS.addInstance();
const RF         = scripting.addModule("/ti/drivers/RF");
const Button     = scripting.addModule("/ti/drivers/apps/Button");
const Button1    = Button.addInstance();
const Button2    = Button.addInstance();
const LED        = scripting.addModule("/ti/drivers/apps/LED");
const LED1       = LED.addInstance();
const LED2       = LED.addInstance();
const ti154stack = scripting.addModule("/ti/ti154stack/ti154stack");

/**
 * Write custom configuration values to the imported modules.
 */
CCFG.enableBootloader         = true;
CCFG.enableBootloaderBackdoor = true;
CCFG.dioBootloaderBackdoor    = 15;
CCFG.levelBootloaderBackdoor  = "Active low";
CCFG.enableCodeGeneration     = false;

Display1.$hardware                = system.deviceData.board.components.XDS110UART;
Display1.$name                    = "CONFIG_DISPLAY";
Display1.uart.$name               = "CONFIG_DISPLAY_UART";
Display1.uart.txPinInstance.$name = "CONFIG_PIN_UART_TX";
Display1.uart.rxPinInstance.$name = "CONFIG_PIN_UART_RX";
Display1.uart.uart.$name          = "MyUART1";

GPIO1.$name             = "CONFIG_GPIO_ZC";
GPIO1.interruptTrigger  = "Rising Edge";
GPIO1.pull              = "Pull Down";
GPIO1.gpioPin.$assign   = "boosterpack.5";
GPIO1.pinInstance.$name = "CONFIG_PIN_3";

GPIO2.mode              = "Output";
GPIO2.pull              = "Pull Down";
GPIO2.$name             = "CONFIG_GPIO_SOLENOID";
GPIO2.gpioPin.$assign   = "boosterpack.24";
GPIO2.pinInstance.$name = "CONFIG_PIN_2";

GPIO3.$name             = "CONFIG_GPIO_HEAT";
GPIO3.mode              = "Output";
GPIO3.pull              = "Pull Down";
GPIO3.gpioPin.$assign   = "boosterpack.15";
GPIO3.pinInstance.$name = "CONFIG_PIN_1";

GPIO4.$name             = "CONFIG_GPIO_LIGHT";
GPIO4.mode              = "Output";
GPIO4.pull              = "Pull Down";
GPIO4.gpioPin.$assign   = "boosterpack.14";
GPIO4.pinInstance.$name = "CONFIG_PIN_0";

GPIO5.$name             = "CONFIG_GPIO_HUM";
GPIO5.mode              = "Output";
GPIO5.pull              = "Pull Down";
GPIO5.gpioPin.$assign   = "boosterpack.18";
GPIO5.pinInstance.$name = "CONFIG_PIN_4";

NVS1.$name                    = "CONFIG_NVSINTERNAL";
NVS1.internalFlash.$name      = "ti_drivers_nvs_NVSCC26XX0";
NVS1.internalFlash.regionBase = 0x2A000;
NVS1.internalFlash.regionSize = 0x4000;

NVS2.$name                    = "CONFIG_NVSINTERNAL1";
NVS2.internalFlash.$name      = "ti_drivers_nvs_NVSCC26XX1";
NVS2.internalFlash.regionType = "Pointer";
NVS2.internalFlash.regionSize = 0x2A000;

Button1.$hardware                 = system.deviceData.board.components["BTN-1"];
Button1.$name                     = "CONFIG_BTN_LEFT";
Button1.gpioPin.$name             = "CONFIG_GPIO_BTN1";
Button1.gpioPin.pinInstance.$name = "CONFIG_PIN_BTN1";

Button2.$hardware                 = system.deviceData.board.components["BTN-2"];
Button2.$name                     = "CONFIG_BTN_RIGHT";
Button2.gpioPin.$name             = "CONFIG_GPIO_BTN2";
Button2.gpioPin.pinInstance.$name = "CONFIG_PIN_BTN2";

LED1.$hardware                 = system.deviceData.board.components.LED_RED;
LED1.$name                     = "CONFIG_LED_RED";
LED1.gpioPin.$name             = "CONFIG_GPIO_RLED";
LED1.gpioPin.pinInstance.$name = "CONFIG_PIN_RLED";

LED2.$hardware                 = system.deviceData.board.components.LED_GREEN;
LED2.$name                     = "CONFIG_LED_GREEN";
LED2.gpioPin.$name             = "CONFIG_GPIO_GLED";
LED2.gpioPin.pinInstance.$name = "CONFIG_PIN_GLED";

ti154stack.project                            = "sensorOAD";
ti154stack.lockProject                        = true;
ti154stack.phyType                            = "phy200kbps";
ti154stack.reportingInterval                  = 5000;
ti154stack.pollingInterval                    = 15000;
ti154stack.aesccmModule.$name                 = "CONFIG_AESCCM_0";
ti154stack.oadSettings.$name                  = "ti_ti154stack_oad_config_ti154stack_oad_mod0";
ti154stack.radioConfig.$name                  = "ti_devices_radioconfig_settings_prop0";
ti154stack.radioConfig.codeExportConfig.$name = "ti_devices_radioconfig_code_export_param0";

/**
 * Pinmux solution for unlocked pins/peripherals. This ensures that minor changes to the automatic solver in a future
 * version of the tool will not impact the pinmux you originally saw.  These lines can be completely deleted in order to
 * re-solve from scratch.
 */
Display1.uart.uart.$suggestSolution       = "UART1";
Display1.uart.uart.txPin.$suggestSolution = "19";
Display1.uart.uart.rxPin.$suggestSolution = "18";
Button1.gpioPin.gpioPin.$suggestSolution  = "21";
Button2.gpioPin.gpioPin.$suggestSolution  = "20";
LED1.gpioPin.gpioPin.$suggestSolution     = "11";
LED2.gpioPin.gpioPin.$suggestSolution     = "12";
